## Kconfig
```kconfig
mainmenu "cos $(ARCH) $(COS_VERSION) kernel configuration"

config KERNEL_NAME
	string
	default "$(KERNEL_NAME)"

config KERNEL_VERSION
	string
	default "$(KERNEL_VERSION)"

source "arch/Kconfig"

source "dev/Kconfig"

source "kernel/Kconfig"

source "lib/Kconfig"

source "mm/Kconfig"
```

## arch/Kconfig
```kconfig
menu "Architecture options"

source "arch/$(ARCH)/Kconfig"

choice
	prompt "Compiler optimization"
	default CC_OPTIMIZE_O2
	help
	  Select compiler optimization options.

config CC_OPTIMIZE_O0
	bool "-O0"

config CC_OPTIMIZE_O1
	bool "-O1"

config CC_OPTIMIZE_O2
	bool "-O2"

config CC_OPTIMIZE_O3
	bool "-O3"

config CC_OPTIMIZE_OS
	bool "-Os"

endchoice

endmenu
```

## arch/x86/Kconfig
```kconfig
config X86
	def_bool y

config 64BIT
	bool "64-bit kernel" if "$(ARCH)" = "x86_64"
	default "$(ARCH)" = "x86_64"
	help
	  Build a 64-bit kernel.

config X86_32
	def_bool y
	depends on !64BIT

config X86_64
	def_bool y
	depends on 64BIT

source "arch/x86/boot/Kconfig"
```

## arch/x86/boot/Kconfig
```kconfig
config BOOTLOADER
	def_bool y
	depends on BOOT_EFISTUB

comment "No bootloader supported"
	depends on !BOOTLOADER

config BOOT_EFISTUB
	bool "Support booting through EFI directly"
	default EFISTUB
	depends on EFISTUB
```

## arch/x86_64/Kconfig
```kconfig
config X86
	def_bool y

config 64BIT
	bool "64-bit kernel"
	default y
	help
	  Build a 64-bit kernel.

config X86_32
	def_bool y
	depends on !64BIT

config X86_64
	def_bool y
	depends on 64BIT

choice
	prompt "Default assembly syntax"
	default ASM_DEFAULT_INTEL
	help
	  When compiling to assembly, this selects the default syntax.

config ASM_DEFAULT_INTEL
	bool "Intel"

config ASM_DEFAULT_ATT
	bool "AT&T"

endchoice

source "arch/x86_64/boot/Kconfig"
```

## arch/x86_64/boot/Kconfig
```kconfig
choice
	prompt "Bootloader"
	default EFISTUB
	help
	  Select bootable image format.

config EFISTUB
	bool "Create a bootable EFI image"

endchoice
```

## dev/Kconfig
```kconfig
menu "Device drivers"

source "dev/firmware/Kconfig"
source "dev/video/Kconfig"
source "dev/tty/Kconfig"

endmenu
```

## dev/clock/Kconfig
```kconfig
config CLOCK_PIT
	bool "PIT (Programmable Interval Timer)"
	default y
	help
	  Basic x86 timer chip.
```

## dev/firmware/Kconfig
```kconfig
menu "Firmware drivers"

if EFISTUB
source "dev/firmware/efistub/Kconfig"
endif

menuconfig ACPI
	bool "ACPI support"
	default y
	help
	  Advanced Configuration and Power Interface support

if ACPI
source "dev/firmware/acpi/Kconfig"
endif

endmenu
```

## dev/firmware/acpi/Kconfig
```kconfig
config ACPI_DEBUG
	bool "ACPI debugging"
	default DEBUG
	depends on DEBUG
	help
	  ACPI debugging
```

## dev/firmware/efistub/Kconfig
```kconfig
config EFISTUB_CONSOLE
	bool "EFI console"
	default y
	depends on EFISTUB
	help
	  Driver for the EFI boot console
```

## dev/tty/serial/Kconfig
```kconfig
config SERIAL
	bool "Serial support (UART)"
	default y
	help
	  UART serial ports support

config SERIAL_CONSOLE
	bool "Serial console"
	default y
	depends on SERIAL
	help
	  Use serial interface as system console

config SERIAL_EARLY_DEBUG
	bool "Early debug serial"
	default n
	depends on DEBUG
	depends on SERIAL_CONSOLE
	help
	  Early boot debugging console on serial port

config SERIAL_DEFAULT_RATE
	int "Default baud rate"
	default 9600
	depends on SERIAL
	help
	  Set default serial baud rate
```

## dev/video/Kconfig
```kconfig
menuconfig VIDEO
	bool "Video drivers"
	default y
	depends on FONT
	help
	  Enable video support.

if VIDEO
source "dev/video/fb/Kconfig"
endif
```

## dev/video/fb/Kconfig
```kconfig
config FB
	bool "Framebuffer support"
	default y
	help
	  Generic framebuffer support.

config FB_EFIGOP
	bool "EFI GOP framebuffer"
	default EFISTUB
	depends on FB
	depends on EFISTUB
	help
	  EFI framebuffer provided by boot services
```

## kernel/Kconfig
```kconfig
menu "General options"

config CMDLINE
	string "Built-in kernel command-line"
	default ""
	help
	  Set a default kernel cmdline.

config CMDLINE_OVERRIDE
	bool "Built-in cmdline override normal one"
	help
	  Built-in command-line override the one provided by the
	  firmware / bootloader.

config DEBUG
	bool "Kernel debugging"
	default n
	help
	  Enable kernel debugging options

config BOOT_BREAKPOINTS
	bool "Early boot breakpoints"
	default DEBUG
	depends on DEBUG
	help
	  Show options to enable/disable early boot breakpoints

config BOOT_BREAKPOINT_BOOTLOADER
	bool "Breakpoint 1: bootloader"
	default n
	depends on BOOT_BREAKPOINTS
	help
	  Breakpoint as soon as the kernel is loaded by the bootloader.

config BOOT_BREAKPOINT_EARLY
	bool "Breakpoint 2: early"
	default n
	depends on BOOT_BREAKPOINTS
	help
	  Breakpoint when kernel starts initializing itself, before scheduling
	  starts.

config BOOT_BREAKPOINT_CORE
	bool "Breakpoint 3: core"
	default n
	depends on BOOT_BREAKPOINTS
	help
	  Breakpoint when kernel initialize core components.

config BOOT_BREAKPOINT_DEVICE
	bool "Breakpoint 4: device"
	default n
	depends on BOOT_BREAKPOINTS
	help
	  Breakpoint when kernel initialize device components.

config BOOT_BREAKPOINT_MISC
	bool "Breakpoint 5: misc"
	default n
	depends on BOOT_BREAKPOINTS
	help
	  Breakpoint when kernel initialize miscellaneous components.

config BOOT_BREAKPOINT_END
	bool "Breakpoint 6: end"
	default n
	depends on BOOT_BREAKPOINTS
	help
	  Breakpoint at the end of kernel initialization, before starting
	  the first userspace process.

source "kernel/compiler/Kconfig"

endmenu
```

## lib/Kconfig
```kconfig
menu "Libraries"

source "lib/fonts/Kconfig"
source "lib/compiler/Kconfig"

endmenu
```

## lib/compiler/Kconfig
```kconfig
if-success = $(shell,{ $(1); } >/dev/null 2>&1 && echo "$(2)" || echo "$(3)")
success = $(if-success,$(1),y,n)
failure = $(if-success,$(1),n,y)

compiler-info = $(shell,$(SRC_ROOT)/scripts/compiler_info "$(1)" "$(2)")
compiler-name = $(shell,set -- $(1) && echo $1)
compiler-version = $(shell,set -- $(1) && echo $2)

cc-info := $(compiler-info,c,"$(CC)")
cc-name := $(compiler-name,$(cc-info))
cc-version := $(compiler-version,$(cc-info))
cxx-info := $(compiler-info,cxx,"$(CXX)")
cxx-name := $(compiler-name,$(cxx-info))
cxx-version := $(compiler-version,$(cxx-info))

$(error-if,$(failure,test -n "$(cc-name)"),C compiler not found)
$(error-if,$(failure,test -n "$(cxx-name)"),C++ compiler not found)

config CC_NAME_STR
	string
	default $(cc-name)

config CC_VERSION_STR
	string
	default $(cc-version)

config CC_IS_GCC
	def_bool $(success,test "$(cc-name)" = GCC)

config CC_IS_CLANG
        def_bool $(success,test "$(cc-name)" = Clang)

config CXX_NAME_STR
	string
	default $(cxx-name)

config CXX_VERSION_STR
	string
	default $(cxx-version)

config CXX_IS_GCC
        def_bool $(success,test "$(cxx-name)" = GCC)

config CXX_IS_CLANG
        def_bool $(success,test "$(cxx-name)" = Clang)

config UBSAN
	bool "ubsan"
	help
	  Undefined behavior sanitizer.

config UBSAN_IMPLICIT_CONVERSION
	bool "ubsan: implicit conversion"
	depends on UBSAN
	help
	  Enable implicit conversion sanitizer.

config STACK_PROTECTOR
	bool "Stack protector"
	help
	  Enable compiler's stack protectors.

config STACK_USAGE
	bool "Stack usage"
	help
	  Generate *.su files containing stack usage information.

config STACK_USAGE_WARN
	int "Warn on big stack usage"
	default 1024
	depends on STACK_USAGE
	help
	  Warn if stack usage greater than provided value.
```

## lib/fonts/Kconfig
```kconfig
menuconfig FONT
	bool "Font support"
	default y
	help
	  Support for fonts.

if FONT

choice
	prompt "Default font"
	default FONT_BUILTIN_TERMINUS_8X16
	depends on FONT
	help
	  Selects the default font for the graphical console.

config FONT_BUILTIN_TERMINUS_8X16
	bool "Terminus 8x16"
	depends on FONT_PSF

endchoice

config FONT_DEFAULT_PATH
	string
	default "font_ter_v16n.psf" if FONT_BUILTIN_TERMINUS_8X16
	default ""
	help
	  Select default font for graphical console.

comment "No default font selected"
	depends on FONT_DEFAULT_PATH = ""

config FONT_PSF
	bool "PSF file format support"
	default y
	help
	  Support the PC Screen Font format.

endif
```

## mm/Kconfig
```kconfig
menu "Memory management"

config MM_DEBUG
	bool "Memory management debug"
	default n
	depends on DEBUG
	help
	  Print memory management debugging information to the console

endmenu
```
